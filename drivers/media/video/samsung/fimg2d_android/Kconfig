## drivers/media/video/samsung/fimg2d_android/Kconfig
```kconfig
# drivers/media/video/samsung/g2d/Kconfig
#
# Copyright (c) 2010 Samsung Electronics Co., Ltd.
# 		http://www.samsung.com/
#
# Licensed under GPLv2

config VIDEO_FIMG2D
	bool "Samsung FIMG-2D Driver"
	depends on VIDEO_SAMSUNG && (CPU_S5PV210 || CPU_EXYNOS4210) && S5P_SYSMMU
	default y
	help
	  This is a graphics 2D (FIMG2D) driver for Samsung EXYNOS4.

config VIDEO_FIMG2D_DEBUG
	bool "G2D Driver Debug Messages"
	depends on VIDEO_FIMG2D
	default n
	help
	  This enables G2D driver debug messages.
```

## sound/soc/codecs/mc1n2/Kconfig
```kconfig
config SND_SOC_MC1N2
	tristate "MC-1N2 SoC Audio Codec"
	depends on SND_SOC && I2C
	select SND_HWDEP

config SND_SOC_USE_EXTERNAL_MIC_BIAS
	bool "MC-1N2 external Mic Bias"

config SND_SOC_MC1N2_DEBUG
	bool "MC-1N2 verbose debug messages while core driver call"
	select SND_DEBUG
	depends on SND_SOC_MC1N2
```
